## CMakeLists.txt
```
# Copyright (c) 2024 Nordic Semiconductor ASA
# SPDX-License-Identifier: Apache-2.0

cmake_minimum_required(VERSION 3.20.0)
find_package(Zephyr REQUIRED HINTS $ENV{ZEPHYR_BASE})

project(cpuapp)
target_sources(app PRIVATE src/main.c)
```

## prj.conf
```kconfig
# Main configuration
CONFIG_UART_CONSOLE=n
CONFIG_SERIAL=n
CONFIG_LOG=n
CONFIG_CONSOLE=n

CONFIG_PM_DEVICE=y
CONFIG_PM_DEVICE_RUNTIME=y
```

## boards/nrf54l15dk_nrf54l15_cpuapp.overlay
```dts
&uart20 {
   status = "disabled";
};
&uart30 {
   status = "disabled";
};
&adc {
    status = "disabled";
};
```

## src/main.c
```c
#include <zephyr/sys/printk.h>
#include <zephyr/kernel.h>

int main(void) {
  printk("HELLO from cpuapp\n");
  while (true) {
    k_msleep(10000);
  }
  return 0;
}
```
